## Project/Kconfig
```kconfig
mainmenu "Startweek options"

config TESTMODE
    bool "Test games manually"
    default n

config NOGPSMODE
    bool "Test without GPS functionality"
    default n

config NOTIMEMODE
    bool "Test without time functionality"
    default n

config GITGUD
    bool "Test without being able to replay games"
    default n

source "Kconfig.zephyr"
```

## Project/boards/native_sim.conf
```kconfig
#CONFIG_LV_Z_MEM_POOL_SIZE=163840
#CONFIG_LV_Z_SHELL=y
CONFIG_MAIN_STACK_SIZE=16384

CONFIG_GPIO=y
CONFIG_INPUT=y
CONFIG_LOG=y
CONFIG_SHELL=y

CONFIG_DISPLAY=y
CONFIG_EMUL=y
CONFIG_GPIO_EMUL=y
CONFIG_GPIO_EMUL_SDL=y
CONFIG_EMUL_LOG_LEVEL_DBG=y

# LVGL config
# CONFIG_LVGL=y
# CONFIG_LV_MEM_CUSTOM=y
# CONFIG_LV_USE_LOG=y
# CONFIG_LV_USE_LABEL=y
# CONFIG_LV_USE_BTN=y
# CONFIG_LV_USE_ARC=y
# CONFIG_LV_USE_IMG=y

CONFIG_ENTROPY_GENERATOR=y
```

## Project/tests/testcase.yaml
```yaml
tests:
  testing.framework_tests:
    build_only: false
    platform_allow: nucleo_h743zi
  testing.testAccelerometer:
    build_only: false
    platform_allow: nucleo_h743zi
  testing.testMagnetometer:
    build_only: false
    platform_allow: nucleo_h743zi
  testing.testCompass:
    build_only: false
    platform_allow: nucleo_h743zi
  testing.testCircleMatrix:
    build_only: false
    platform_allow: nucleo_h743zi
  testing.testGenericGpio:
    build_only: false
    platform_allow: nucleo_h743zi
  testing.testLcd:
    build_only: false
    platform_allow: nucleo_h743zi
  testing.testLedMatrix:
    build_only: false
    platform_allow: nucleo_h743zi
  testing.sevenSegmentMatrix:
    build_only: false
    platform_allow: nucleo_h743zi
  testing.testHelperFunctions:
    build_only: false
    platform_allow: nucleo_h743zi
  testing.testMg10:
    build_only: false
    platform_allow: nucleo_h743zi
  testing.testAll:
    build_only: false
    platform_allow: nucleo_h743zi
```
